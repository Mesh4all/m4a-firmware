## firmware/sys/serialization/Kconfig
```kconfig
menu "Serialization"
    config SERIALIZATION_BUFF_SIZE
    int "Default buff size"
    default 100
endmenu
```

## firmware/sys/uniqueid/Kconfig
```kconfig
menu "Uniqueid"

    config HEADER_ADDRESS_ID
        string "IPV6 HEADER"
        default "2001:db8:1:1"

    choice IPV6_MODE
        prompt "Select IPV6 Subnet mode"
        config MODE_STATIC
            bool "STATIC"

        if USEMODULE_AT86RF2XX || USEMODULE_AT86RF215 || USEMODULE_PERIPH_HWRNG
        config MODE_RANDOM
            bool "RANDOM"
        endif
    endchoice

endmenu
```

## tests/border_router/Kconfig
```kconfig
rsource "../../firmware/network/net_tools/Kconfig"
rsource "../../firmware/network/border_router/Kconfig"
```

## tests/driver_radio/Kconfig
```kconfig
rsource "../../firmware/Kconfig.debug"
rsource "../../firmware/network/radio/Kconfig"
```

## tests/system_storage/Kconfig
```kconfig
rsource "../../firmware/sys/storage/Kconfig"
rsource "../../firmware/Kconfig.debug"

menu "Test Debug"
    config DEBUG_TEST_STORAGE
            bool "Debugging storage Test"
            default n
endmenu
```

## wifi-subsys/main/Kconfig.projbuild
```kconfig
menu "wifi-STA-configuration"
    config STA_WIFI_SSID
        string "WiFi SSID"
        default "myssid"
        help
            SSID (network name) for the example to connect to.

    config STA_WIFI_PASSWORD
        string "WiFi Password"
        default "mypassword"
        help
            WiFi password (WPA or WPA2) for the example to use.

    config ESP_MAXIMUM_RETRY
        int "Maximum retry"
        default 5
        help
            Set the Maximum retry to avoid station reconnecting to the AP unlimited when the AP is really inexistent.

    config ENABLE_STA
        bool "enable STA"
        default n
        help
            enable STA mode
endmenu

menu "wifi-AP-configuration"
    config ESP_WIFI_SSID
        string "WiFi SSID"
        default "myssid"
        help
            SSID (network name) for the example to connect to.

    config ESP_WIFI_PASSWORD
        string "WiFi Password"
        default "mypassword"
        help
            WiFi password (WPA or WPA2) for the example to use.
    config ESP_WIFI_CHANNEL
        int "WiFi Channel"
        range 1 13
        default 1
        help
            WiFi channel (network channel) for the example to use.

    config ESP_MAX_STA_CONN
        int "Maximal STA connections"
        default 4
        help
            Max number of the STA connects to AP.

    config ENABLE_AP
        bool "enable AP"
        default n
        help
            enable AP mode
endmenu
```

## wifi-subsys/test/sdkconfig.defaults
```kconfig
# CONFIG_TASK_WDT_PANIC is not set
CONFIG_TASK_WDT_TIMEOUT_S=5
CONFIG_TASK_WDT_CHECK_IDLE_TASK_CPU0=y
CONFIG_TASK_WDT_CHECK_IDLE_TASK_CPU1=n
```
