## boards/m4a-24g/Kconfig.periph
```kconfig
choice
    prompt "ADC_VREF"

config ADC_VREF_DEFAULT
    bool "Default ADC Reference Voltage - 1V"

config ADC_VREF_INTVCC0
    bool "ADC Reference Voltage - 1/1.48 VDDANA"

config ADC_VREF_INTVCC1
    bool "ADC Reference Voltage - 1/2 VDDANA"

config ADC_VREF_EXT1
    bool "External Voltage ADC ref 1"

config ADC_VREF_EXT2
    bool "External Voltage ADC ref 2"
endchoice
```

## boards/m4a-wroom/Kconfig
```kconfig
# Copyright (c) 2020 HAW Hamburg
#
# This file is subject to the terms and conditions of the GNU Lesser
# General Public License v2.1. See the file LICENSE in the top level
# directory for more details.

config BOARD
    default "m4a-wroom" if BOARD_M4A_WROOM

config BOARD_M4A_WROOM
    bool
    default y
    select BOARD_COMMON_ESP32
    select CPU_MODEL_ESP32_WROOM_32
    select HAS_PERIPH_ADC
    select HAS_PERIPH_DAC
    select HAS_PERIPH_I2C
    select HAS_PERIPH_PWM
    select HAS_PERIPH_SPI

source "$(RIOTBOARD)/common/esp32/Kconfig"
```

## examples/border_router/Kconfig
```kconfig
menu    "Border-Router Example configuration"
    rsource "../../firmware/network/border_router/Kconfig"
    rsource "../../firmware/network/rpl_protocol/Kconfig"
endmenu
```

## examples/border_router_example/Kconfig
```kconfig
menu "Border_Router_Example_Configs"

    config RTR_IPV6
    string "Router net ipv6"
    default "2001:db8:1::1"

    rsource "../../firmware/network/rpl_protocol/Kconfig"
endmenu
```

## examples/mesh4all_rpl_dag/Kconfig
```kconfig
menu "RPL settings"
#comment "RPL settings"
    config IS_DODAG
    bool "dodag node"
    default n

endmenu #RPL
```

## examples/rpl_dodag/Kconfig
```kconfig
menu "RPL settings"
#comment "RPL settings"
    config IS_DODAG
    bool "dodag node"
    default y

    config DODAG_INSTANCE
    int "Default DODAG instance"
    default 1

    config DODAG_IPV6_ADDRESS
    string "Wireless Address of DODAG"
    default "2001:db8::1"

endmenu #RPL
```

## examples/system_example/Kconfig
```kconfig
menu "example configuration"

rsource "../../firmware/sys/Kconfig"
rsource "../../firmware/network/Kconfig"

menu "Interface"
#comment "Interface wifi and Radio"
config WIFI_SUBSYSTEM
    bool "Wifi-Subsytem Interface"
    default y

config IEEE_802154
    bool "Radio Interface"
    default n
endmenu #interface
endmenu
```

## firmware/Kconfig
```kconfig
menu "m4a-firmware configuration"
rsource "peripherals/Kconfig"
rsource "sys/Kconfig"
rsource "network/Kconfig"

menu "Interface"
#comment "Interface wifi and Radio"
config WIFI_SUBSYSTEM
    bool "Wifi-Subsytem Interface"
    default y

config IEEE_802154
    bool "Radio Interface"
    default n
endmenu #interface
endmenu

rsource "Kconfig.debug"
```

## firmware/Kconfig.debug
```kconfig
menu "Debug mode"

    menu "Network"
        config DEBUG_BORDER_ROUTER
            bool "Debugging Border Router module"

            default n
            depends on USEMODULE_BORDER_ROUTER

        config DEBUG_CHAMOS
            bool "Debugging chamos module"
            default n
            depends on USEMODULE_CHAMOS

        config DEBUG_NET_TOOLS
            bool "Debugging net_tools module"
            default n
            depends on USEMODULE_NET_TOOLS

        config DEBUG_RADIO
            bool "Debugging radio module"
            default n
            depends on USEMODULE_RADIO

        config DEBUG_RPL_PROTOCOL
            bool "Debugging RPL protocol module"
            default n
            depends on USEMODULE_RPL_PROTOCOL

        config DEBUG_UDP_CLIENT
            bool "Debugging udp_client module"
            default n
            depends on USEMODULE_UDP_CLIENT

        config DEBUG_UDP_SERVER
            bool "Debugging udp_server module"
            default n
            depends on USEMODULE_UDP_SERVER

    endmenu # network modules

    menu "Peripherals"

        config DEBUG_DS18_SENSOR
            bool "Debugging ds18_sensor module"
            default n
            depends on USEMODULE_DS18_SENSOR

        config DEBUG_MOISTURE_SENSOR
            bool "Debugging moisture_sensor module"
            default n
            depends on USEMODULE_MOISTURE_SENSOR

    endmenu # peripherals

    menu "Sys"

    config DEBUG_AT_CLIENT
            bool "Debugging AT_client module"
            default n
            depends on USEMODULE_AT_CLIENT

    config DEBUG_SERIALIZATION
            bool "Debugging serialization module"
            default n
            depends on USEMODULE_SERIALIZATION

    config DEBUG_STORAGE
            bool "Debugging storage module"
            default n
            depends on USEMODULE_STORAGE

    config DEBUG_UNIQUEID
            bool "Debugging uniqueid module"
            default n
            depends on USEMODULE_UNIQUEID

    endmenu
endmenu # Debug mode
```

## firmware/network/Kconfig
```kconfig
menu "Network"
rsource "chamos/Kconfig"
rsource "radio/Kconfig"
rsource "rpl_protocol/Kconfig"
rsource "udp_client/Kconfig"
rsource "udp_server/Kconfig"
rsource "net_tools/Kconfig"
endmenu
```

## firmware/network/border_router/Kconfig
```kconfig
menu "Border Router"

            config WIRED_INTERFACE

                int "WIRED"
                default 0
                range 0 1

            config WIRELESS_INTERFACE

                int "WIRELESS"
                default 2
                range 2 3

    config ADDR_IPV6_WIRELESS
        bool "Edit IPV6 Wireless"
        default n

        menu "Change Wireless IPV6"
        visible if ADDR_IPV6_WIRELESS
            config ADDRESS_IPV6_WIRELESS
                string "Wireless address IPV6"
                default "2001:db8:2::1"

        endmenu # Change wireless IPV6

    config ADDR_IPV6_WIRED
        bool "Edit IPV6 Wired"
        default n
        menu "Change Wired IPV6"
        visible if ADDR_IPV6_WIRED

        config ADDRESS_IPV6_WIRED
            string "Wired address IPV6"
            default "2001:db8:1::1"

endmenu # Change wired IPV6

endmenu
```

## firmware/network/chamos/Kconfig
```kconfig
menu "Chamos server"
    config HEADER_ADDRESS_MULTICAST
        string "MULTICAST IPV6 HEADER"
        default "ff02::1"

    config SERVER_BUFFER_SIZE
        int "Default server buffer size"
        default 20
        range 20  100
endmenu
```

## firmware/network/net_tools/Kconfig
```kconfig
menu "Net tools"
    config PREFIX_DISPLACEMENT
        int "Prefix displacement"
        default 8
        range 4  9
endmenu
```

## firmware/network/radio/Kconfig
```kconfig
menu "PHY settings"
depends on IEEE_802154
#comment "PHY settings"
    config MODE_SUB_24GHZ
    bool "Mode Sub 2.4GHz"
    default n
    depends on USEMODULE_AT86RF215 || USEMODULE_CC2538_RF

    #AT86RF215
    config TX_POWER
    int "Default TX Power"
    default 0
    range -28 3
    depends on USEMODULE_AT86RF215

    #AT86RF233
    config TX_POWER
    int "Default TX Power"
    default 0
    range -17  4
    depends on USEMODULE_AT86RF233

    #CC2538
    config TX_POWER
    int "Default TX Power"
    default 0
    range -24 7
    depends on USEMODULE_CC2538_RF

    config RADIO_CHANNEL
    int "Default Radio Channel"
    default 11
    range 11 26
    depends on !MODE_SUB_24GHZ

    config SUB_RADIO_CHANNEL
    int "Default Radio Channel Sub 2.4GHz"
    default 0
    range 0 10
    depends on MODE_SUB_24GHZ

endmenu #Phy
```

## firmware/network/rpl_protocol/Kconfig
```kconfig
menu "RPL settings"
#comment "RPL settings"
    config IS_DODAG
    bool "dodag node"
    default n

    config DODAG_INSTANCE
    int "Default DODAG instance"
    default 1
    range 1 256

endmenu #RPL
```

## firmware/network/udp_client/Kconfig
```kconfig
menu "UDP Client"
    config UDP_CLIENT_PORT
    int "Default port"
    default 3000
endmenu
```

## firmware/network/udp_server/Kconfig
```kconfig
menu "UDP Server"
    config UDP_SERVER_PORT
    int "Default port"
    default 3000
endmenu
```

## firmware/peripherals/Kconfig
```kconfig
menu "Peripherals"
menu "Hardware Periph Setup"
if BOARD_M4A_24G
rsource "../../boards/m4a-24g/Kconfig.periph"
endif
endmenu
rsource "ds18_sensor/Kconfig"
rsource "moisture_sensor/Kconfig"
endmenu
```

## firmware/peripherals/ds18_sensor/Kconfig
```kconfig
menu "ds18 for soil"
    config PIN_TEMP_SENSOR
    int "Pin to connect temperature sensor"
    default 5
endmenu
```

## firmware/peripherals/moisture_sensor/Kconfig
```kconfig
menu "Moisture sensor setup"
choice ADC_RES
    prompt "ADC_BITS_RESOLUTION"
    default ADC_RES_10BIT

config ADC_RES_6BIT
    bool "ADC resolution: 6 bit"

config ADC_RES_8BIT
    bool "ADC resolution: 8 bit"

config ADC_RES_10BIT
    bool "ADC resolution: 10 bit"

config ADC_RES_12BIT
    bool "ADC resolution: 12 bit"

config ADC_RES_14BIT
    bool "ADC resolution: 14 bit"

config ADC_RES_1B6IT
    bool "ADC resolution: 16 bit"
endchoice

config ADC_RES
int

default 255 if ADC_RES_6BIT
default 48 if ADC_RES_8BIT
default 32 if ADC_RES_10BIT
default 0 if ADC_RES_12BIT
default 254 if ADC_RES_14BIT
default 253 if ADC_RES_16BIT
endmenu
```

## firmware/sys/Kconfig
```kconfig
rsource "../../firmware/Kconfig.debug"

menu "System"
rsource "uniqueid/Kconfig"
rsource "serialization/Kconfig"
rsource "storage/Kconfig"
rsource "at_client/Kconfig"
endmenu
```

## firmware/sys/at_client/Kconfig
```kconfig
menu "AT Client"
    config WAIT_RESPONSE
    int "SECONDS TO WAIT RESPONSE"
    default 10
    range 10 20
endmenu
```
